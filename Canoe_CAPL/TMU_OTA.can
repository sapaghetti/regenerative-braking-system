/*@!Encoding:65001*/
/* TMU 측 CAPL */

variables
{
  msTimer checkTimer;
  dword hFile;
  char ecu_buffer[256];
  char version_buffer[256];
  char change_buf[256];
  char ecu_info[4][10] = {"Init", "CGW", "TMU", "EDT"};
  char system_ver_buf[256];
  int i;
  int ecu_cnt = 3;
  int otaReady = 0;    // -1: , 0: 준비 안됨, 1: 사용자 승인 대기, 2: 승인됨, 3: 거부됨 4: 업데이트 완료
  int ecu_num = 0;
  long result;
  long len = 256;
  
  message 0x500 otaRequestMsg;
}

on start
{
  setTimer(checkTimer, 1000);
}

on timer checkTimer
{
  
  if (otaReady == 0)
  {
    // OTA flag 감지 -> 
    hFile = openFileRead("C:\\vscodestudy\\OTA_download\\Sapaghetti.bin", 0);
    if (hFile != 0)
    {
      //result = fileGetBinaryBlock(version_buffer, len, hFile); // bin파일값 저장
      result = fileGetString(ecu_buffer, len, hFile);
      result = fileGetString(version_buffer, len, hFile);
      ecu_num = ecu_buffer[0] - '0';
      @sysvar::Next_Ver[ecu_num] = version_buffer[0] - '0';
      
      fileClose(hFile);
      if (result > 0 && @sysvar::Cur_Ver[ecu_num] != @sysvar::Next_Ver[ecu_num])
      {
        write(">>> OTA 준비됨 → CGW 에 승인 요청 전송");
        write(">> OTA ECU: %d, NEW VERSION %d", ecu_num, @sysvar::Next_Ver[ecu_num]);
        // CGW 에 승인 요청 전송
        otaRequestMsg.byte(0) = 0x01;  // OTA 승인 요청
        output(otaRequestMsg);
        otaReady = 1;  // 사용자 응답 대기 상태로 변경
      }
    }
  }
  else if (otaReady == 2)
  {
    otaReady = -1;
    write("TMU -> CGW OTA 수행 명령 및 .bin 파일 전달");
    otaRequestMsg.byte(0) = 0x03;  // TMU -> CGW
    output(otaRequestMsg);
  }
  else if (otaReady == 3)
  {
    // 사용자 거부됨 → flag 상태 업데이트 (STATUS: REJECTED)
    /*hFile = openFileWrite("C:\\vscodestudy\\OTA_flag\\ota_complete.flag", 0);
    if (hFile != 0)
    {
      snprintf(change_buf, len, "STATUS: REJECTED");
      filePutString(change_buf, len, hFile);
      fileClose(hFile);
      write(">>> OTA 거부됨 → STATUS: REJECTED 로 업데이트");
    }
    */
     otaReady = 1;  // 사용자 응답 대기 상태로 변경
     write(">>> CGW에 승인 요청 재전송");
     write(">> OTA ECU: %d, NEW VERSION %d", ecu_num, @sysvar::Next_Ver[ecu_num]);
     // CGW 에 승인 요청 전송
     otaRequestMsg.byte(0) = 0x01;  // OTA 승인 요청
     output(otaRequestMsg);
  }
  else if (otaReady == 4)
  {
    //서버로 완료 플래그 보내는 코드 작성해야함
   
    hFile = openFileWrite("System_version.txt", 0);
    if (hFile != 0)
    {
      write(">>> System_version 작성");
      for (i = 1; i <= ecu_cnt; i++)
      {
        snprintf(system_ver_buf, len, "%s: %d\n", ecu_info[i], @sysvar::Cur_Ver[i]);
        filePutString(system_ver_buf, len, hFile);
      }
      fileClose(hFile);
    }
    otaReady = 0;
  }
  setTimer(checkTimer, 1000);
}

on message 0x501
{
  //write(">>> CGW 응답 수신: Data[0] = %d", this.byte(0));

  if (this.byte(0) == 0x01)
  {
    otaReady = 2;  // 사용자 승인됨
  }
  else if (this.byte(0) == 0x02)
  {
    otaReady = 3;  // 사용자 거부됨
  }
  else if (this.byte(0) == 0x05)  // OTA 완료
  {
    otaReady = 4;
  }
}
