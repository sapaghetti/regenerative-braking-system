/*@!Encoding:65001*/
includes
{
  
}

variables
{
  msTimer otaTimer;
  enum STATE
  {
    NOMAR_MODE,
    BOOTLOADER_MODE,
    OTA_COMPLETE
  }edtState = BOOTLOADER_MODE;
  message 0x502 OTAResultMsg;
  dword hFile;
  char update_ver[1];
  char cur_ver[2];
  byte bytebuffer[256];
  long len = 256;
  long result;
  int mode = 0; // 0 : 첫 부팅시 부트로더 모드, 1 : ota로 인한 부트로더 모드, 2 : 기본
  int ota_result = 0;
  int cur_edt_version = 0;
  int version_num[11] = {0, 1, 2, 3, 4, 5,
                         6, 7, 8, 9, 10};
}
on start
{
  setTimer(otaTimer, 100);
}

int writeBootloader()
{
  hFile = openFileWrite("EDT_version.txt", 0);
  if (hFile != 0)
  {
    snprintf(update_ver, 8, "%d", cur_edt_version);
    filePutString(update_ver, 1, hFile);
    fileClose(hFile);
    return 1;
  }
  else
  {
    return 0;
  }
}
void updateVersion()
{
  @sysvar::Cur_Ver[3] = @sysvar::Next_Ver[3];
  cur_edt_version = @sysvar::Next_Ver[3];
}
void readBootloader()
{
  hFile = openFileRead("EDT_version.txt", 0);
  fileGetString(cur_ver, 2, hFile);
  @sysvar::Cur_Ver[3] = _atoi64(cur_ver);
  cur_edt_version = @sysvar::Cur_Ver[3];
  fileClose(hFile);
}
on timer otaTimer
{
  switch (edtState)
  {
    case NOMAR_MODE: // Default
      if (cur_edt_version >= version_num[1])
      {
        // version : 1
      }
      if (cur_edt_version >= version_num[2])
      {
        // version : 2
        if (@sysvar::Distance > 20)
        {
          if (@sysvar::vehSpeed <= 200)
          {
            @sysvar::vehSpeed += @sysvar::addSpeed*0.0002;
          }
        }
        else
        {
          if (@sysvar::vehSpeed > 0)
          {
            @sysvar::vehSpeed--;   
          }
        } 
      }
      break;
    case BOOTLOADER_MODE:
      if (mode == 0)
      {
        write(">>> 첫 부팅 bootMode 진입");
        readBootloader(); // 현재 저장된 버전 가져오기
        edtState = NOMAR_MODE;
      }
      else if (mode == 1)
      {
        write(">>> OTA bootMode 진입");
        updateVersion();
        ota_result = writeBootloader();
        edtState = OTA_COMPLETE;
      }
      
      break;
    case OTA_COMPLETE:
      write(">>> 현재 버전: %d", cur_edt_version);
      if (ota_result == 1)
      {
        write(">>> OTA Success!");
        OTAResultMsg.byte(0) = 0x05; // Send Complete Msg to CGW
        output(OTAResultMsg);
      }
      else
      {
        write(">>> OTA Fail!");
        OTAResultMsg.byte(0) = 0xFF;
      }
      edtState = NOMAR_MODE;
      break;
  }
  setTimer(otaTimer, 100);
}

on message 0x501
{
  if (this.byte(0) == 0x04)
  {
    if (@sysvar::Next_Ver[3] != 0)
    {
      mode = 1;
      edtState = BOOTLOADER_MODE;
    }
  }
}


