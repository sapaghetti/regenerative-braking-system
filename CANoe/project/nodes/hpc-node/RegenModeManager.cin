/*@!Encoding:65001*/
// CAN-??

variables
{
  enum Regen_Mode
  {
    REGEN_LEVEL_0 = 0,
    REGEN_LEVEL_1 = 1,
    REGEN_LEVEL_2 = 2,
    REGEN_LEVEL_3 = 3,
    REGEN_AUTO = 4
  };
}

void RegenModeManager_setRegenMode() // CAN-94
{  
  int mode;
  mode = @HPC::sv_Regen_Mode;
  if(mode < 0 || mode > 4)
  {
    write("Invalid regen mode: %d", mode);
    return;
  }
  
  if(@HPC::sv_Regen_Mode == mode)
  {
    write("Same Mode requested: %d", mode);
    return;
  }
  
  @HPC::sv_Regen_Mode = mode;
  // @HPC::sv_Regen_Mode_Changed = true;
  write("Regen Mode changed to: %d", mode);
  
  //tmp_Regen_Torque_Cmd.Regen_Mode = mode;
  //output(tmp_Regen_Torque_Cmd);
  @HPC::sv_Regen_Mode_Changed = 0;
}

on key '0' 
{ 
  @HPC::sv_Regen_Mode = REGEN_LEVEL_0;
  @HPC::sv_Regen_Mode_Changed = 1;
}
on key '1' 
{ 
  @HPC::sv_Regen_Mode = REGEN_LEVEL_1; 
  @HPC::sv_Regen_Mode_Changed = 1;
}
on key '2' 
{ 
  @HPC::sv_Regen_Mode = REGEN_LEVEL_2; 
  @HPC::sv_Regen_Mode_Changed = 1;
}
on key '3' 
{ 
  @HPC::sv_Regen_Mode = REGEN_LEVEL_3;
  @HPC::sv_Regen_Mode_Changed = 1;
}
on key '4' 
{
  @HPC::sv_Regen_Mode = REGEN_AUTO;
}