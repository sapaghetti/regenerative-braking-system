/*@!Encoding:65001*/
void OnEnterFailSafe()
{
  write("ZCU_Front: FAIL-SAFE mode activated. Transmissions stopped.");
}

void OnEnterDegraded()
{
  write("ZCU_Front: DEGRADED mode activated");
}

void OnEnterNormal()
{
  write("ZCU_Front: NORMAL operation resumed");
}

void TransitionToState(enum SystemState newState)
{
  if (newState != currentState) {
    previousState = currentState;
    currentState = newState;
    
    write("ZCU_Front: State transition %d -> %d", previousState, currentState);
    
    switch (newState) {
      case STATE_FAIL_SAFE: OnEnterFailSafe(); break;
      case STATE_DEGRADED: OnEnterDegraded(); break;
      case STATE_NORMAL: OnEnterNormal(); break;
      default: break;
    }
  }
}

void UpdateSystemState()
{
  if (faultRegister & FAULT_HPC_COMM) {
    if (currentState != STATE_FAIL_SAFE) TransitionToState(STATE_FAIL_SAFE);
    return;
  }
  
  if (faultRegister == 0) {
    if (currentState == STATE_INIT && commMon.firstMsgReceived_HPC) {
        TransitionToState(STATE_NORMAL);
    } else if (currentState != STATE_NORMAL && currentState != STATE_INIT) {
        TransitionToState(STATE_NORMAL);
    }
  }
}

void ClearFault(dword faultBit)
{
  faultRegister &= ~faultBit;
  diagnostics.errorFlags = faultRegister;
}

void SetFault(dword faultBit)
{
  if((faultRegister & faultBit) == 0)
  {
    faultRegister |= faultBit;
    diagnostics.errorFlags = faultRegister;
    UpdateSystemState();
  }
}

void MonitorCommunication()
{
  dword currentTime;
  dword elapsedTime;
  
  currentTime = timeNowNS() / 1000000;
  
  if (commMon.firstMsgReceived_HPC) {
    elapsedTime = currentTime - commMon.lastRxTime_HPC;
    if (elapsedTime > TIMEOUT_HPC) {
      commMon.failureCount_HPC++;
      if (commMon.failureCount_HPC >= MAX_COMM_FAILURES) {
        SetFault(FAULT_HPC_COMM);
      }
    }
  }
}

void InitializeGlobals()
{
  dword initTime;

  initTime = timeNowNS() / 1000000;

  sensors.sensorsValid = 0;

  commMon.lastRxTime_HPC = initTime;
  commMon.failureCount_HPC = 0;
  commMon.firstMsgReceived_HPC = 0;

  diagnostics.errorFlags = 0;
  
  faultRegister = 0;
  currentState = STATE_INIT;
  previousState = STATE_INIT;
  
  gTaskCounter = 0;
}
