/*@!Encoding:65001*/
/**
 * @file ZCU_Front.can
 * @brief ZCU_Front의 메인 CAPL 스크립트
 * @author jjongs2
 * @version 1.00
 * @date 2025-06-15
 */

includes
{
  #include "ZCU_Front_Config.cin"
  #include "ZCU_Front_Functions.cin"
}

/**
 * @brief 시뮬레이션 시작 시 호출되는 이벤트 핸들러
 * @note 전역 변수 초기화, 보안 부팅, 자체 테스트 수행 및 주기적 타이머 설정
 */
on start
{
  write("ZCU_Front ECU Starting - Version %d.%02d", (SYSTEM_VERSION >> 8), (SYSTEM_VERSION & 0xFF));

  if (!PerformSecureBoot())
  {
    write("ZCU_Front: Secure Boot FAILED - System halted");
    stop();
    return;
  }

  InitializeGlobals();
  PerformInitialSelfTest();
  write("ZCU_Front: Initialization complete. Waiting for system to be ready...");
  setTimerCyclic(timerMainTask, MAIN_CYCLE);
}

/**
 * @brief 시뮬레이션 중지 시 호출되는 이벤트 핸들러
 * @note 시스템 종료 작업을 수행
 */
on stopMeasurement
{
  write("ZCU_Front: Shutting down...");
  write("ZCU_Front: Shutdown complete");
}

/**
 * @brief 주기적인 메인 태스크 타이머 이벤트 핸들러
 * @note 시스템 상태에 따라 다양한 주기로 작업을 예약하고 실행
 *       - 10ms: 브레이크 페달 메시지 전송
 *       - 20ms: 차량 동역학 메시지 전송
 *       - 50ms: 워치독 검사
 *       - 100ms: 진단, 통신 모니터링, 상태 업데이트
 */
on timer timerMainTask
{
  if(currentState != STATE_FAIL_SAFE)
  {
    SendM005_EXT_BrakePedal();

    if ((gTaskCounter % 2) == 0)
    {
      SendM005_VehicleDynamics();
    }

    if ((gTaskCounter % 5) == 0)
    {
      PerformWatchdog();
    }
  }

  if ((gTaskCounter % 10) == 0)
  {
    PerformDiagnostics();
    if (currentState != STATE_INIT)
    {
      MonitorCommunication();
    }
    UpdateSystemState();
  }

  gTaskCounter++;
}

/**
 * @brief EPAS 데이터 메시지 수신 이벤트 핸들러
 * @note EPAS로부터 조향 데이터를 수신하고 통신 상태 및 센서 유효성 검증
 */
on message L001_EPAS_Data
{
  if(commMon.firstMsgReceived_EPAS == 0)
  {
    write("ZCU_Front: First EPAS message received.");
    commMon.firstMsgReceived_EPAS = 1;
  }
  commMon.lastRxTime_EPAS = timeNowNS() / 1000000;

  if (this.Message_Counter == ((gLastEpasCounter + 1) & 0x0F))
  {
    commMon.failureCount_EPAS = 0;
    ClearFault(FAULT_EPAS_COMM);

    sensors.steeringAngle = this.Steering_Angle;
    sensors.steeringTorque = this.Steering_Torque;
    sensors.angularVelocity = this.Angular_Velocity;
    sensors.epasStatus = this.EPAS_Status;

    if(ValidateSensorRange(sensors.steeringAngle, -STEERING_MAX, STEERING_MAX) != 0)
    {
      SetFault(FAULT_SENSOR_RANGE);
      sensors.sensorsValid &= ~0x01;
    }
    else
    {
      sensors.sensorsValid |= 0x01;
    }
    commMon.commStatus |= 0x01;
  }
  else
  {
    if (gLastEpasCounter != 0)
    {
      commMon.failureCount_EPAS++;
      SetFault(FAULT_EPAS_COMM);
    }
  }
  gLastEpasCounter = this.Message_Counter;
}

/**
 * @brief ADAS 센서 데이터 메시지 수신 이벤트 핸들러
 * @note ADAS로부터 센서 데이터를 수신하고 통신 상태 및 센서 유효성 검증
 */
on message L002_ADAS_Sensor
{
  if(commMon.firstMsgReceived_ADAS == 0)
  {
    write("ZCU_Front: First ADAS message received.");
    commMon.firstMsgReceived_ADAS = 1;
  }
  commMon.lastRxTime_ADAS = timeNowNS() / 1000000;

  sensors.frontVehicleDistance = this.Front_Vehicle_Distance;
  sensors.frontVehicleSpeed = this.Front_Vehicle_Speed;
  sensors.laneChangeIndicator = this.Lane_Change_Indicator;
  sensors.roadCondition = this.Road_Condition;

  if (sensors.frontVehicleDistance >= 0 && sensors.frontVehicleDistance <= 6553.5 &&
      sensors.frontVehicleSpeed >= 0 && sensors.frontVehicleSpeed <= 6553.5)
  {
    sensors.sensorsValid |= 0x02;
    commMon.failureCount_ADAS = 0;
    ClearFault(FAULT_ADAS_COMM);
    commMon.commStatus |= 0x02;
  }
  else
  {
    sensors.sensorsValid &= ~0x02;
    SetFault(FAULT_SENSOR_RANGE);
  }
}

/**
 * @brief 키보드 'f' 키 입력 이벤트 핸들러
 * @note 수동으로 EPAS 통신 폴트를 주입하여 테스트
 */
on key 'f'
{
  write("ZCU_Front: Manual fault injection - EPAS_COMM");
  SetFault(FAULT_EPAS_COMM);
}

/**
 * @brief 키보드 'c' 키 입력 이벤트 핸들러
 * @note 모든 폴트를 지우고 상태를 초기화
 */
on key 'c'
{
  write("ZCU_Front: Clearing all faults");
  faultRegister = 0;
  diagnostics.errorFlags = 0;
  commMon.failureCount_EPAS = 0;
  commMon.failureCount_ADAS = 0;
  TransitionToState(STATE_INIT);
}

/**
 * @brief 키보드 's' 키 입력 이벤트 핸들러
 * @note 현재 ZCU_Front의 모든 주요 상태 정보를 콘솔에 출력
 */
on key 's'
{
  write("=== ZCU_Front Status ===");
  write("State: %d, Faults: 0x%08X", currentState, faultRegister);
  write("APS: %.1f%%, BPPS: %.1f%%, Speed: %.1fkm/h", sensors.apsPosition, sensors.bppsPosition, sensors.vehicleSpeed);
  write("EPAS: Angle=%.1fdeg, Torque=%.1fNm, Status=%d", sensors.steeringAngle, sensors.steeringTorque, sensors.epasStatus);
  write("ADAS: Distance=%.1fm, Speed=%.1fkm/h", sensors.frontVehicleDistance, sensors.frontVehicleSpeed);
  write("Comm: EPAS Fail=%d, ADAS Fail=%d, Status=0x%02X, EPAS Rx=%d, ADAS Rx=%d",
        commMon.failureCount_EPAS, commMon.failureCount_ADAS, commMon.commStatus, commMon.firstMsgReceived_EPAS, commMon.firstMsgReceived_ADAS);
  write("========================");
}
