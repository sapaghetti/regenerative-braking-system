/*@!Encoding:65001*/
void SetFault(dword faultBit)
{
  if((faultRegister & faultBit) == 0)
  {
    faultRegister |= faultBit;
    UpdateSystemState();
  }
}

void UpdateSystemState()
{
  if (faultRegister & FAULT_HPC_COMM)
  {
    if (currentState != STATE_DEGRADED && currentState != STATE_FAIL_SAFE) 
      currentState = STATE_DEGRADED;
    return;
  }

  if (faultRegister == 0)
  {
    if (currentState == STATE_INIT && commMon.firstMsgReceived_M012)
    {
      currentState = STATE_NORMAL;
    }
    else if (currentState != STATE_NORMAL && currentState != STATE_INIT)
    {
      currentState = STATE_NORMAL;
    }
  }
}

void MonitorCommunication()
{
  dword currentTime;
  dword elapsedTime;

  currentTime = timeNowNS() / 1000000;

  if (commMon.firstMsgReceived_M012)
  {
    elapsedTime = currentTime - commMon.lastRxTime_M012;
    if (elapsedTime > TIMEOUT_HPC_M012)
    {
      commMon.failureCount_M012++;
      if (commMon.failureCount_M012 >= MAX_COMM_FAILURES)
      {
        SetFault(FAULT_HPC_COMM);
        commMon.commStatus &= ~0x01;
      }
    }
  }
}

void InitializeGlobals()
{
  dword initTime;
  initTime = timeNowNS() / 1000000;

  commMon.lastRxTime_M012 = initTime;
  commMon.lastRxTime_M009 = initTime;
  commMon.failureCount_M012 = 0;
  commMon.failureCount_M009 = 0;
  commMon.commStatus = 0;
  commMon.firstMsgReceived_M012 = 0;
  commMon.firstMsgReceived_M009 = 0;
  commMon.lastTxTime_M008 = 0;
  commMon.waitingForResponse = 0;

  faultRegister = 0;
  currentState = STATE_INIT;
  previousState = STATE_INIT;
  gTaskCounter = 0;
}
