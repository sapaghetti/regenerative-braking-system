/*@!Encoding:65001*/
includes
{
  #include "ZCU_Center_Config.cin"
  #include "ZCU_Center_Functions.cin"
}

on start
{
  write("ZCU_Center ECU Starting - Version %d.%02d", (SYSTEM_VERSION >> 8), (SYSTEM_VERSION & 0xFF));

  if (!PerformSecureBoot())
  {
    write("ZCU_Center: Secure Boot FAILED - System halted");
    stop();
    return;
  }

  InitializeGlobals();
  
  write("ZCU_Center: Initialization complete. Starting timers...");
  setTimerCyclic(timerMainTask, MAIN_CYCLE);
}

on timer timerMainTask
{
  if(currentState != STATE_FAIL_SAFE)
  {
    if ((gTaskCounter % 10) == 0)
    {
      if (currentState != STATE_INIT)
      {
        MonitorCommunication();
      }
    }

    if ((gTaskCounter % 100) == 0)
    {
      PerformDiagnostics();
      if (currentState != STATE_FAIL_SAFE)
      {
        SendDiagnosticData();
      }
    }
  }
  gTaskCounter++;
}

on key 'f'
{
  SetFault(FAULT_HPC_COMM);
}
