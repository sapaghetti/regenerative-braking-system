/*@!Encoding:65001*/
includes
{
  #include "ZCU_Center_Config.cin"
  #include "ZCU_Center_Functions.cin"
}

on start
{
  write("ZCU_Center ECU Starting - Version %d.%02d", (SYSTEM_VERSION >> 8), (SYSTEM_VERSION & 0xFF));

  if (!PerformSecureBoot())
  {
    write("ZCU_Center: Secure Boot FAILED - System halted");
    stop();
    return;
  }

  InitializeGlobals();
  PerformInitialSelfTest();
  
  write("ZCU_Center: Initialization complete. Starting timers...");
  setTimerCyclic(timerMainTask, MAIN_CYCLE);
}

on stopMeasurement
{
  write("ZCU_Center: Shutting down...");
  
  sysSetVariableInt("ZCU_Sim", "Center_System_Status", 0);
  
  write("ZCU_Center: Shutdown complete");
}

on timer timerMainTask
{
  if(currentState != STATE_FAIL_SAFE)
  {
    if ((gTaskCounter % 5) == 0)
    {
      PerformWatchdog();
    }

    if ((gTaskCounter % 10) == 0)
    {
      if (currentState != STATE_INIT)
      {
        MonitorCommunication();
      }
      UpdateSystemState();
    }

    if ((gTaskCounter % 100) == 0)
    {
      PerformDiagnostics();
      if (currentState != STATE_FAIL_SAFE)
      {
        SendDiagnosticData();
      }
    }
  }

  gTaskCounter++;
}

on message L003_Voice_Command
{
  dword currentTime;
  byte requestedMode;
  byte dataArray[6];

  currentTime = timeNowNS() / 1000000;

  write("ZCU_Center: Voice command received - Type=%d, Value=%d, Confidence=%d%%", 
        this.Command_Type, this.Command_Value, this.Confidence_Level);

  dataArray[0] = this.Command_Type;
  dataArray[1] = this.Command_Value;
  dataArray[2] = this.Confidence_Level;
  dataArray[3] = this.Language_ID;
  dataArray[4] = (byte)(this.Voice_Timestamp & 0xFF);
  dataArray[5] = (byte)((this.Voice_Timestamp >> 8) & 0xFF);
  
  if (!VerifyE2EProtection(dataArray, elcount(dataArray), this.CRC16_Checksum))
  {
    write("ZCU_Center: Voice command E2E verification failed, ignoring");
    return;
  }

  if (!ValidateVoiceInput(this.Command_Type, this.Command_Value, this.Confidence_Level, currentTime))
  {
    return;
  }

  hmiInput.lastVoiceTime = currentTime;
  hmiInput.lastVoiceCommandType = this.Command_Type;
  hmiInput.lastVoiceCommandValue = this.Command_Value;
  hmiInput.lastVoiceConfidence = this.Confidence_Level;
  hmiInput.voiceValid = 1;

  if (commMon.waitingForResponse)
  {
    write("ZCU_Center: Already waiting for mode change response, ignoring voice command");
    return;
  }

  requestedMode = DetermineRequestedModeFromVoice(this.Command_Type, this.Command_Value);
  if (requestedMode != 0xFF)
  {
    SendModeChangeRequest(requestedMode, REQUEST_SOURCE_VOICE, clusterDisplay.activeProfile);
  }
  else if (this.Command_Type == VOICE_CMD_PROFILE_CHANGE)
  {
    byte newProfile;
    newProfile = (clusterDisplay.activeProfile == PROFILE_EFFICIENCY) ? PROFILE_COMFORT : PROFILE_EFFICIENCY;
    SendModeChangeRequest(clusterDisplay.currentDisplayMode, REQUEST_SOURCE_VOICE, newProfile);
  }
  else if (this.Command_Type == VOICE_CMD_SYSTEM_INFO)
  {
    write("ZCU_Center: System info request via voice - Mode=%d, Profile=%d", 
          clusterDisplay.currentDisplayMode, clusterDisplay.activeProfile);
  }
}

on message L004_SW_Button_Input
{
  dword currentTime;
  byte requestedMode;
  byte dataArray[6];

  currentTime = timeNowNS() / 1000000;

  write("ZCU_Center: Button input received - ID=%d, Action=%d, Duration=%dms", 
        this.Button_ID, this.Button_Action, this.Press_Duration);

  dataArray[0] = this.Button_ID;
  dataArray[1] = this.Button_Action;
  dataArray[2] = (byte)(this.Press_Duration & 0xFF);
  dataArray[3] = (byte)((this.Press_Duration >> 8) & 0xFF);
  dataArray[4] = (byte)(this.Event_Timestamp & 0xFF);
  dataArray[5] = (byte)((this.Event_Timestamp >> 8) & 0xFF);
  
  if (!VerifyE2EProtection(dataArray, elcount(dataArray), this.CRC16_Checksum))
  {
    write("ZCU_Center: Button input E2E verification failed, ignoring");
    return;
  }

  if (!ValidateButtonInput(this.Button_ID, this.Button_Action, this.Press_Duration, currentTime))
  {
    return;
  }

  hmiInput.lastButtonTime = currentTime;
  hmiInput.lastButtonID = this.Button_ID;
  hmiInput.lastButtonAction = this.Button_Action;
  hmiInput.buttonValid = 1;

  if (commMon.waitingForResponse)
  {
    write("ZCU_Center: Already waiting for mode change response, ignoring button input");
    return;
  }

  if (this.Button_ID == BUTTON_PROFILE_CHANGE && this.Button_Action == BUTTON_ACTION_PRESS)
  {
    byte newProfile;
    newProfile = (clusterDisplay.activeProfile == PROFILE_EFFICIENCY) ? PROFILE_COMFORT : PROFILE_EFFICIENCY;
    SendModeChangeRequest(clusterDisplay.currentDisplayMode, REQUEST_SOURCE_BUTTON, newProfile);
    return;
  }

  requestedMode = DetermineRequestedModeFromButton(this.Button_ID, this.Button_Action);
  if (requestedMode != 0xFF)
  {
    SendModeChangeRequest(requestedMode, REQUEST_SOURCE_BUTTON, clusterDisplay.activeProfile);
  }
}

on message M009_Mode_Change_Resp
{
  dword currentTime, responseTime;
  byte dataArray[6];

  currentTime = timeNowNS() / 1000000;

  if(commMon.firstMsgReceived_M009 == 0)
  {
    write("ZCU_Center: First M009 message received.");
    commMon.firstMsgReceived_M009 = 1;
  }
  commMon.lastRxTime_M009 = currentTime;

  write("ZCU_Center: Mode change response received - Status=%d, Mode=%d, Profile=%d, Reason=%d", 
        this.Mode_Change_Status, this.Current_Mode, this.Active_Profile, this.Failure_Reason);

  dataArray[0] = this.Current_Mode;
  dataArray[1] = this.Mode_Change_Status;
  dataArray[2] = this.Active_Profile;
  dataArray[3] = this.Failure_Reason;
  dataArray[4] = (byte)(this.Response_Timestamp & 0xFF);
  dataArray[5] = (byte)((this.Response_Timestamp >> 8) & 0xFF);
  
  if (!VerifyE2EProtection(dataArray, elcount(dataArray), this.CRC16_Checksum))
  {
    write("ZCU_Center: Mode change response E2E verification failed, ignoring");
    return;
  }

  if (commMon.waitingForResponse)
  {
    responseTime = currentTime - commMon.lastTxTime_M008;
    diagnostics.lastResponseTime = responseTime;
    if (diagnostics.averageResponseTime == 0)
      diagnostics.averageResponseTime = responseTime;
    else
      diagnostics.averageResponseTime = (diagnostics.averageResponseTime + responseTime) / 2;

    write("ZCU_Center: HMI response time: %dms (average: %dms)", responseTime, diagnostics.averageResponseTime);
  }

  commMon.waitingForResponse = 0;
  hmiInput.pendingModeRequest = 0;

  if (this.Mode_Change_Status == 0)
  {
    clusterDisplay.currentDisplayMode = this.Current_Mode;
    clusterDisplay.activeProfile = this.Active_Profile;
    
    UpdateOTAComfortMode(this.Active_Profile);
    
    ClearFault(FAULT_MODE_CHANGE_FAIL);
    ClearFault(FAULT_HMI_TIMEOUT);
    
    write("ZCU_Center: Mode change successful - New mode: %d, Profile: %d", 
          this.Current_Mode, this.Active_Profile);
  }
  else
  {
    SetFault(FAULT_MODE_CHANGE_FAIL);
    write("ZCU_Center: Mode change failed - Reason: %d", this.Failure_Reason);
    
    switch (this.Failure_Reason)
    {
      case 1:
        clusterDisplay.warningStatus |= WARNING_SYSTEM_FAULT;
        break;
      case 2:
        clusterDisplay.warningStatus |= WARNING_BATTERY;
        break;
      case 3:
        clusterDisplay.warningStatus |= WARNING_SYSTEM_FAULT;
        break;
      default:
        break;
    }
    UpdateClusterDisplay();
  }

  commMon.failureCount_M009 = 0;
  ClearFault(FAULT_HPC_COMM);
  commMon.commStatus |= 0x02;
}

on message M012_Cluster_Display
{
  dword currentTime;
  byte dataArray[6];

  currentTime = timeNowNS() / 1000000;

  if(commMon.firstMsgReceived_M012 == 0)
  {
    write("ZCU_Center: First M012 message received.");
    commMon.firstMsgReceived_M012 = 1;
  }
  commMon.lastRxTime_M012 = currentTime;

  dataArray[0] = this.Display_Mode;
  dataArray[1] = (byte)(this.Instant_Regen_Power & 0xFF);
  dataArray[2] = (byte)((this.Instant_Regen_Power >> 8) & 0xFF);
  dataArray[3] = (byte)(this.Cumulative_Regen_Energy & 0xFF);
  dataArray[4] = (byte)((this.Cumulative_Regen_Energy >> 8) & 0xFF);
  dataArray[5] = this.Warning_Status;
  
  if (!VerifyE2EProtection(dataArray, elcount(dataArray), this.CRC16_Checksum))
  {
    write("ZCU_Center: Cluster display data E2E verification failed, ignoring");
    return;
  }

  clusterDisplay.currentDisplayMode = this.Display_Mode;
  clusterDisplay.instantRegenPower = this.Instant_Regen_Power;
  clusterDisplay.cumulativeRegenEnergy = this.Cumulative_Regen_Energy;
  clusterDisplay.warningStatus = this.Warning_Status;

  UpdateClusterDisplay();

  commMon.failureCount_M012 = 0;
  ClearFault(FAULT_HPC_COMM);
  commMon.commStatus |= 0x01;
}

on key 'f'
{
  write("ZCU_Center: Manual fault injection - HPC_COMM");
  SetFault(FAULT_HPC_COMM);
}

on key 'b'
{
  write("ZCU_Center: Simulating button press - Mode Up");
  
  if (!commMon.waitingForResponse)
  {
    byte requestedMode;
    requestedMode = (clusterDisplay.currentDisplayMode + 1) % MAX_REGEN_MODES;
    SendModeChangeRequest(requestedMode, REQUEST_SOURCE_BUTTON, clusterDisplay.activeProfile);
  }
  else
  {
    write("ZCU_Center: Already waiting for response, ignoring simulation");
  }
}

on key 'v'
{
  write("ZCU_Center: Simulating voice command - Auto mode");
  
  if (!commMon.waitingForResponse)
  {
    SendModeChangeRequest(MODE_AUTO, REQUEST_SOURCE_VOICE, clusterDisplay.activeProfile);
  }
  else
  {
    write("ZCU_Center: Already waiting for response, ignoring simulation");
  }
}

on key 'p'
{
  write("ZCU_Center: Simulating profile change");
  
  if (!commMon.waitingForResponse)
  {
    byte newProfile;
    newProfile = (clusterDisplay.activeProfile == PROFILE_EFFICIENCY) ? PROFILE_COMFORT : PROFILE_EFFICIENCY;
    SendModeChangeRequest(clusterDisplay.currentDisplayMode, REQUEST_SOURCE_BUTTON, newProfile);
  }
  else
  {
    write("ZCU_Center: Already waiting for response, ignoring simulation");
  }
}

on key 'c'
{
  write("ZCU_Center: Clearing all faults");
  faultRegister = 0;
  diagnostics.errorFlags = 0;
  commMon.failureCount_M012 = 0;
  commMon.failureCount_M009 = 0;
  commMon.waitingForResponse = 0;
  hmiInput.pendingModeRequest = 0;
  clusterDisplay.warningStatus = 0;
  UpdateClusterDisplay();
  TransitionToState(STATE_INIT);
}

on key 's'
{
  write("=== ZCU_Center Status ===");
  write("State: %d, Faults: 0x%08X", currentState, faultRegister);
  write("Current Mode: %d, Active Profile: %d", clusterDisplay.currentDisplayMode, clusterDisplay.activeProfile);
  write("Instant Power: %dW, Cumulative Energy: %dWh", clusterDisplay.instantRegenPower, clusterDisplay.cumulativeRegenEnergy);
  write("Warning Status: 0x%02X, Comfort Mode: %d", clusterDisplay.warningStatus, clusterDisplay.comfortModeEnabled);
  write("Comm Status: 0x%02X, M012 Fail: %d, M009 Fail: %d", 
        commMon.commStatus, commMon.failureCount_M012, commMon.failureCount_M009);
  write("Waiting for Response: %d, Pending Request: %d", commMon.waitingForResponse, hmiInput.pendingModeRequest);
  write("Last Response Time: %dms, Average: %dms", diagnostics.lastResponseTime, diagnostics.averageResponseTime);
  write("CPU: %d%%, Memory: %d%%, Temp: %d°C", diagnostics.cpuUsage, diagnostics.memoryUsage, diagnostics.temperature);
  write("========================");
}

on key 't'
{
  write("ZCU_Center: Testing cluster display with sample data");
  
  clusterDisplay.instantRegenPower = 5000;
  clusterDisplay.cumulativeRegenEnergy = 1500;
  clusterDisplay.warningStatus = WARNING_BATTERY;
  
  UpdateClusterDisplay();
}
