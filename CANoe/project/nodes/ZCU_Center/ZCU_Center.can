/*@!Encoding:65001*/
/**
 * @file ZCU_Center.can
 * @brief ZCU_Center의 메인 CAPL 스크립트
 * @author jjongs2
 * @version 1.00
 * @date 2025-06-16
 */

includes
{
  #include "ZCU_Center_Config.cin"
  #include "ZCU_Center_Functions.cin"
}

/**
 * @brief 시뮬레이션 시작 시 호출되는 이벤트 핸들러
 * @note 전역 변수 초기화, 보안 부팅, 자체 테스트 수행 및 주기적 타이머 설정
 */
on start
{
  write("ZCU_Center ECU Starting - Version %d.%02d", (SYSTEM_VERSION >> 8), (SYSTEM_VERSION & 0xFF));

  if (!PerformSecureBoot())
  {
    write("ZCU_Center: Secure Boot FAILED - System halted");
    stop();
    return;
  }

  InitializeGlobals();
  PerformInitialSelfTest();
  
  write("ZCU_Center: Initialization complete. Starting timers...");
  setTimerCyclic(timerMainTask, MAIN_CYCLE);
}

/**
 * @brief 시뮬레이션 중지 시 호출되는 이벤트 핸들러
 * @note 시스템 종료 작업을 수행
 */
on stopMeasurement
{
  write("ZCU_Center: Shutting down...");
  
  // 클러스터에 시스템 종료 알림
  sysSetVariableInt("ZCU_Sim", "Center_System_Status", 0);
  
  write("ZCU_Center: Shutdown complete");
}

/**
 * @brief 주기적인 메인 태스크 타이머 이벤트 핸들러 (10ms 주기)
 * @note 시스템 상태에 따라 다양한 주기로 작업을 예약하고 실행
 *       - 50ms: 워치독 검사
 *       - 100ms: 통신 모니터링, 상태 업데이트
 *       - 1000ms: 진단 수행, 진단 데이터 전송
 */
on timer timerMainTask
{
  if(currentState != STATE_FAIL_SAFE)
  {
    // 50ms 주기 작업 (5 * 10ms)
    if ((gTaskCounter % 5) == 0)
    {
      PerformWatchdog();
    }

    // 100ms 주기 작업 (10 * 10ms)
    if ((gTaskCounter % 10) == 0)
    {
      if (currentState != STATE_INIT)
      {
        MonitorCommunication();
      }
      UpdateSystemState();
    }

    // 1000ms 주기 작업 (100 * 10ms)
    if ((gTaskCounter % 100) == 0)
    {
      PerformDiagnostics();
      if (currentState != STATE_FAIL_SAFE)
      {
        SendDiagnosticData();
      }
    }
  }

  gTaskCounter++;
}

/**
 * @brief 음성 명령 메시지 수신 이벤트 핸들러
 * @note 음성인식 ECU로부터 음성 명령을 수신하고 처리
 */
on message L003_Voice_Command
{
  dword currentTime;
  byte requestedMode;
  byte dataArray[6];

  currentTime = timeNowNS() / 1000000;

  write("ZCU_Center: Voice command received - Type=%d, Value=%d, Confidence=%d%%", 
        this.Command_Type, this.Command_Value, this.Confidence_Level);

  // E2E 보호 검증
  dataArray[0] = this.Command_Type;
  dataArray[1] = this.Command_Value;
  dataArray[2] = this.Confidence_Level;
  dataArray[3] = this.Language_ID;
  dataArray[4] = (byte)(this.Voice_Timestamp & 0xFF);
  dataArray[5] = (byte)((this.Voice_Timestamp >> 8) & 0xFF);
  
  if (!VerifyE2EProtection(dataArray, elcount(dataArray), this.CRC16_Checksum))
  {
    write("ZCU_Center: Voice command E2E verification failed, ignoring");
    return;
  }

  // 음성 입력 유효성 검증
  if (!ValidateVoiceInput(this.Command_Type, this.Command_Value, this.Confidence_Level, currentTime))
  {
    return;
  }

  // 음성 입력 데이터 저장
  hmiInput.lastVoiceTime = currentTime;
  hmiInput.lastVoiceCommandType = this.Command_Type;
  hmiInput.lastVoiceCommandValue = this.Command_Value;
  hmiInput.lastVoiceConfidence = this.Confidence_Level;
  hmiInput.voiceValid = 1;

  // 응답 대기 중이면 무시
  if (commMon.waitingForResponse)
  {
    write("ZCU_Center: Already waiting for mode change response, ignoring voice command");
    return;
  }

  // 모드 변경 명령 처리
  requestedMode = DetermineRequestedModeFromVoice(this.Command_Type, this.Command_Value);
  if (requestedMode != 0xFF)
  {
    SendModeChangeRequest(requestedMode, REQUEST_SOURCE_VOICE, clusterDisplay.activeProfile);
  }
  else if (this.Command_Type == VOICE_CMD_PROFILE_CHANGE)
  {
    // 프로파일 변경 명령
    byte newProfile;
    newProfile = (clusterDisplay.activeProfile == PROFILE_EFFICIENCY) ? PROFILE_COMFORT : PROFILE_EFFICIENCY;
    SendModeChangeRequest(clusterDisplay.currentDisplayMode, REQUEST_SOURCE_VOICE, newProfile);
  }
  else if (this.Command_Type == VOICE_CMD_SYSTEM_INFO)
  {
    // 시스템 정보 요청 - 클러스터에 상세 정보 표시
    write("ZCU_Center: System info request via voice - Mode=%d, Profile=%d", 
          clusterDisplay.currentDisplayMode, clusterDisplay.activeProfile);
  }
}

/**
 * @brief 스티어링 휠 버튼 입력 메시지 수신 이벤트 핸들러
 * @note 스티어링 휠 버튼 입력을 수신하고 처리
 */
on message L004_SW_Button_Input
{
  dword currentTime;
  byte requestedMode;
  byte dataArray[6];

  currentTime = timeNowNS() / 1000000;

  write("ZCU_Center: Button input received - ID=%d, Action=%d, Duration=%dms", 
        this.Button_ID, this.Button_Action, this.Press_Duration);

  // E2E 보호 검증
  dataArray[0] = this.Button_ID;
  dataArray[1] = this.Button_Action;
  dataArray[2] = (byte)(this.Press_Duration & 0xFF);
  dataArray[3] = (byte)((this.Press_Duration >> 8) & 0xFF);
  dataArray[4] = (byte)(this.Event_Timestamp & 0xFF);
  dataArray[5] = (byte)((this.Event_Timestamp >> 8) & 0xFF);
  
  if (!VerifyE2EProtection(dataArray, elcount(dataArray), this.CRC16_Checksum))
  {
    write("ZCU_Center: Button input E2E verification failed, ignoring");
    return;
  }

  // 버튼 입력 유효성 검증
  if (!ValidateButtonInput(this.Button_ID, this.Button_Action, this.Press_Duration, currentTime))
  {
    return;
  }

  // 버튼 입력 데이터 저장
  hmiInput.lastButtonTime = currentTime;
  hmiInput.lastButtonID = this.Button_ID;
  hmiInput.lastButtonAction = this.Button_Action;
  hmiInput.buttonValid = 1;

  // 응답 대기 중이면 무시
  if (commMon.waitingForResponse)
  {
    write("ZCU_Center: Already waiting for mode change response, ignoring button input");
    return;
  }

  // 프로파일 변경 버튼 처리
  if (this.Button_ID == BUTTON_PROFILE_CHANGE && this.Button_Action == BUTTON_ACTION_PRESS)
  {
    byte newProfile;
    newProfile = (clusterDisplay.activeProfile == PROFILE_EFFICIENCY) ? PROFILE_COMFORT : PROFILE_EFFICIENCY;
    SendModeChangeRequest(clusterDisplay.currentDisplayMode, REQUEST_SOURCE_BUTTON, newProfile);
    return;
  }

  // 모드 변경 버튼 처리
  requestedMode = DetermineRequestedModeFromButton(this.Button_ID, this.Button_Action);
  if (requestedMode != 0xFF)
  {
    SendModeChangeRequest(requestedMode, REQUEST_SOURCE_BUTTON, clusterDisplay.activeProfile);
  }
}

/**
 * @brief 모드 변경 응답 메시지 수신 이벤트 핸들러
 * @note HPC로부터 모드 변경 응답을 수신하고 처리
 */
on message M009_Mode_Change_Resp
{
  dword currentTime, responseTime;
  byte dataArray[6];

  currentTime = timeNowNS() / 1000000;

  if(commMon.firstMsgReceived_M009 == 0)
  {
    write("ZCU_Center: First M009 message received.");
    commMon.firstMsgReceived_M009 = 1;
  }
  commMon.lastRxTime_M009 = currentTime;

  write("ZCU_Center: Mode change response received - Status=%d, Mode=%d, Profile=%d, Reason=%d", 
        this.Mode_Change_Status, this.Current_Mode, this.Active_Profile, this.Failure_Reason);

  // E2E 보호 검증
  dataArray[0] = this.Current_Mode;
  dataArray[1] = this.Mode_Change_Status;
  dataArray[2] = this.Active_Profile;
  dataArray[3] = this.Failure_Reason;
  dataArray[4] = (byte)(this.Response_Timestamp & 0xFF);
  dataArray[5] = (byte)((this.Response_Timestamp >> 8) & 0xFF);
  
  if (!VerifyE2EProtection(dataArray, elcount(dataArray), this.CRC16_Checksum))
  {
    write("ZCU_Center: Mode change response E2E verification failed, ignoring");
    return;
  }

  // 응답 시간 측정
  if (commMon.waitingForResponse)
  {
    responseTime = currentTime - commMon.lastTxTime_M008;
    diagnostics.lastResponseTime = responseTime;
    if (diagnostics.averageResponseTime == 0)
      diagnostics.averageResponseTime = responseTime;
    else
      diagnostics.averageResponseTime = (diagnostics.averageResponseTime + responseTime) / 2;

    write("ZCU_Center: HMI response time: %dms (average: %dms)", responseTime, diagnostics.averageResponseTime);
  }

  // 응답 처리
  commMon.waitingForResponse = 0;
  hmiInput.pendingModeRequest = 0;

  if (this.Mode_Change_Status == 0)  // 성공
  {
    // 클러스터 표시 데이터 업데이트
    clusterDisplay.currentDisplayMode = this.Current_Mode;
    clusterDisplay.activeProfile = this.Active_Profile;
    
    // OTA 편안한 모드 UI 업데이트
    UpdateOTAComfortMode(this.Active_Profile);
    
    ClearFault(FAULT_MODE_CHANGE_FAIL);
    ClearFault(FAULT_HMI_TIMEOUT);
    
    write("ZCU_Center: Mode change successful - New mode: %d, Profile: %d", 
          this.Current_Mode, this.Active_Profile);
  }
  else  // 실패
  {
    SetFault(FAULT_MODE_CHANGE_FAIL);
    write("ZCU_Center: Mode change failed - Reason: %d", this.Failure_Reason);
    
    // 실패 사유에 따른 처리
    switch (this.Failure_Reason)
    {
      case 1:  // Safety
        clusterDisplay.warningStatus |= WARNING_SYSTEM_FAULT;
        break;
      case 2:  // Battery
        clusterDisplay.warningStatus |= WARNING_BATTERY;
        break;
      case 3:  // System_Fault
        clusterDisplay.warningStatus |= WARNING_SYSTEM_FAULT;
        break;
      default:
        break;
    }
    UpdateClusterDisplay();
  }

  commMon.failureCount_M009 = 0;
  ClearFault(FAULT_HPC_COMM);
  commMon.commStatus |= 0x02;
}

/**
 * @brief 클러스터 표시 데이터 메시지 수신 이벤트 핸들러
 * @note HPC로부터 클러스터 표시 정보를 수신하고 클러스터를 업데이트
 */
on message M012_Cluster_Display
{
  dword currentTime;
  byte dataArray[6];

  currentTime = timeNowNS() / 1000000;

  if(commMon.firstMsgReceived_M012 == 0)
  {
    write("ZCU_Center: First M012 message received.");
    commMon.firstMsgReceived_M012 = 1;
  }
  commMon.lastRxTime_M012 = currentTime;

  // E2E 보호 검증
  dataArray[0] = this.Display_Mode;
  dataArray[1] = (byte)(this.Instant_Regen_Power & 0xFF);
  dataArray[2] = (byte)((this.Instant_Regen_Power >> 8) & 0xFF);
  dataArray[3] = (byte)(this.Cumulative_Regen_Energy & 0xFF);
  dataArray[4] = (byte)((this.Cumulative_Regen_Energy >> 8) & 0xFF);
  dataArray[5] = this.Warning_Status;
  
  if (!VerifyE2EProtection(dataArray, elcount(dataArray), this.CRC16_Checksum))
  {
    write("ZCU_Center: Cluster display data E2E verification failed, ignoring");
    return;
  }

  // 클러스터 표시 데이터 업데이트
  clusterDisplay.currentDisplayMode = this.Display_Mode;
  clusterDisplay.instantRegenPower = this.Instant_Regen_Power;
  clusterDisplay.cumulativeRegenEnergy = this.Cumulative_Regen_Energy;
  clusterDisplay.warningStatus = this.Warning_Status;

  // 클러스터 하드웨어 업데이트
  UpdateClusterDisplay();

  commMon.failureCount_M012 = 0;
  ClearFault(FAULT_HPC_COMM);
  commMon.commStatus |= 0x01;
}

/**
 * @brief 키보드 'f' 키 입력 이벤트 핸들러
 * @note 수동으로 HPC 통신 폴트를 주입하여 테스트
 */
on key 'f'
{
  write("ZCU_Center: Manual fault injection - HPC_COMM");
  SetFault(FAULT_HPC_COMM);
}

/**
 * @brief 키보드 'b' 키 입력 이벤트 핸들러
 * @note 수동으로 버튼 입력을 시뮬레이션 (테스트용)
 */
on key 'b'
{
  write("ZCU_Center: Simulating button press - Mode Up");
  
  if (!commMon.waitingForResponse)
  {
    byte requestedMode;
    requestedMode = (clusterDisplay.currentDisplayMode + 1) % MAX_REGEN_MODES;
    SendModeChangeRequest(requestedMode, REQUEST_SOURCE_BUTTON, clusterDisplay.activeProfile);
  }
  else
  {
    write("ZCU_Center: Already waiting for response, ignoring simulation");
  }
}

/**
 * @brief 키보드 'v' 키 입력 이벤트 핸들러
 * @note 수동으로 음성 명령을 시뮬레이션 (테스트용)
 */
on key 'v'
{
  write("ZCU_Center: Simulating voice command - Auto mode");
  
  if (!commMon.waitingForResponse)
  {
    SendModeChangeRequest(MODE_AUTO, REQUEST_SOURCE_VOICE, clusterDisplay.activeProfile);
  }
  else
  {
    write("ZCU_Center: Already waiting for response, ignoring simulation");
  }
}

/**
 * @brief 키보드 'p' 키 입력 이벤트 핸들러
 * @note 수동으로 프로파일 변경을 시뮬레이션 (테스트용)
 */
on key 'p'
{
  write("ZCU_Center: Simulating profile change");
  
  if (!commMon.waitingForResponse)
  {
    byte newProfile;
    newProfile = (clusterDisplay.activeProfile == PROFILE_EFFICIENCY) ? PROFILE_COMFORT : PROFILE_EFFICIENCY;
    SendModeChangeRequest(clusterDisplay.currentDisplayMode, REQUEST_SOURCE_BUTTON, newProfile);
  }
  else
  {
    write("ZCU_Center: Already waiting for response, ignoring simulation");
  }
}

/**
 * @brief 키보드 'c' 키 입력 이벤트 핸들러
 * @note 모든 폴트를 지우고 상태를 초기화
 */
on key 'c'
{
  write("ZCU_Center: Clearing all faults");
  faultRegister = 0;
  diagnostics.errorFlags = 0;
  commMon.failureCount_M012 = 0;
  commMon.failureCount_M009 = 0;
  commMon.waitingForResponse = 0;
  hmiInput.pendingModeRequest = 0;
  clusterDisplay.warningStatus = 0;
  UpdateClusterDisplay();
  TransitionToState(STATE_INIT);
}

/**
 * @brief 키보드 's' 키 입력 이벤트 핸들러
 * @note 현재 ZCU_Center의 모든 주요 상태 정보를 콘솔에 출력
 */
on key 's'
{
  write("=== ZCU_Center Status ===");
  write("State: %d, Faults: 0x%08X", currentState, faultRegister);
  write("Current Mode: %d, Active Profile: %d", clusterDisplay.currentDisplayMode, clusterDisplay.activeProfile);
  write("Instant Power: %dW, Cumulative Energy: %dWh", clusterDisplay.instantRegenPower, clusterDisplay.cumulativeRegenEnergy);
  write("Warning Status: 0x%02X, Comfort Mode: %d", clusterDisplay.warningStatus, clusterDisplay.comfortModeEnabled);
  write("Comm Status: 0x%02X, M012 Fail: %d, M009 Fail: %d", 
        commMon.commStatus, commMon.failureCount_M012, commMon.failureCount_M009);
  write("Waiting for Response: %d, Pending Request: %d", commMon.waitingForResponse, hmiInput.pendingModeRequest);
  write("Last Response Time: %dms, Average: %dms", diagnostics.lastResponseTime, diagnostics.averageResponseTime);
  write("CPU: %d%%, Memory: %d%%, Temp: %d°C", diagnostics.cpuUsage, diagnostics.memoryUsage, diagnostics.temperature);
  write("========================");
}

/**
 * @brief 키보드 't' 키 입력 이벤트 핸들러
 * @note 클러스터 표시 테스트용 데이터를 시뮬레이션
 */
on key 't'
{
  write("ZCU_Center: Testing cluster display with sample data");
  
  clusterDisplay.instantRegenPower = 5000;  // 5kW
  clusterDisplay.cumulativeRegenEnergy = 1500;  // 1.5kWh
  clusterDisplay.warningStatus = WARNING_BATTERY;
  
  UpdateClusterDisplay();
}
