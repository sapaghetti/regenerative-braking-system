/*@!Encoding:65001*/
/**
 * @file ZCU_Rear.can
 * @brief ZCU_Rear의 메인 CAPL 스크립트
 */

includes
{
  
}

variables
{
  /*******************************************************************************
   * 타이머 설정
   ******************************************************************************/
  
  /** @brief MCU 제어 메시지 전송 타이머 */
  msTimer mcu_ctrl_msg_Timer;
  /** @brief MCU 제어 메시지 전송 주기 (ms) */
  const dword MCU_CTRL_MSG_TIMEOUT = 10;
  
  /** @brief 피드백 메시지 전송 타이머 */
  msTimer fb_msg_Timer;
  /** @brief 피드백 메시지 전송 주기 (ms) */
  const dword FB_MSG_TIMEOUT = 100;
}

/**
 * @brief 시뮬레이션 시작 시 호출되는 이벤트 핸들러
 * @note MCU 제어 메시지와 피드백 메시지 전송 타이머를 초기화
 */
on start
{
  settimer(mcu_ctrl_msg_Timer, MCU_CTRL_MSG_TIMEOUT);
  settimer(fb_msg_Timer, FB_MSG_TIMEOUT);
}

/**
 * @brief MCU 제어 메시지 전송 타이머 이벤트 핸들러
 * @note 10ms 주기로 MCU에 회생 모드와 목표 토크 정보를 전송
 *       - 회생 제동 모드 설정
 *       - 목표 토크 값 전달
 */
on timer mcu_ctrl_msg_Timer
{
  message L008_MCU_Control mcu_ctrl_msg;
  
  mcu_ctrl_msg.Regen_Mode = @ZCU_Rear::Regen_Mode;
  mcu_ctrl_msg.Target_Torque.phys = @ZCU_Rear::Target_Torque;
  output(mcu_ctrl_msg);
  cancelTimer(mcu_ctrl_msg_Timer);
  settimer(mcu_ctrl_msg_Timer, MCU_CTRL_MSG_TIMEOUT);
}

/**
 * @brief 피드백 메시지 전송 타이머 이벤트 핸들러
 * @note 100ms 주기로 배터리 상태와 회생 토크 피드백 정보를 전송
 *       - 배터리 기본 정보 (SOC, 전류, 전압, 온도)
 *       - 실제 회생 토크 피드백
 */
on timer fb_msg_Timer
{
  
  message M006_Battery_Basic battery_msg;
  message M002_Regen_Torque_Feedback torque_msg;
  
  torque_msg.Actual_Regen_Torque.phys = @ZCU_Rear::Motor_Torque;
  output(torque_msg);
  
  battery_msg.Battery_SOC = @ZCU_Rear::SoC;
  battery_msg.Battery_Current.phys = @ZCU_Rear::Current;
  battery_msg.Battery_Voltage.phys = @ZCU_Rear::Voltage;
  battery_msg.Battery_Temp = 30;
  output(battery_msg);
  
  cancelTimer(fb_msg_Timer);
  settimer(fb_msg_Timer, FB_MSG_TIMEOUT);
}

/**
 * @brief MCU 상세 상태 메시지 수신 이벤트 핸들러
 * @note MCU로부터 실제 모터 토크 정보를 수신하여 내부 변수에 저장
 */
on message L005_MCU_Detail_Status
{
  @ZCU_Rear::Motor_Torque = this.Motor_Torque.phys;
}

/**
 * @brief BMS 상세 상태 메시지 수신 이벤트 핸들러
 * @note BMS로부터 배터리 상태 정보를 수신하여 내부 변수에 저장
 *       - 배터리 SOC (State of Charge)
 *       - 배터리 전류
 *       - 배터리 전압
 */
on message L007_BMS_Detail_Status
{
  @ZCU_Rear::SoC = this.Battery_SoC;
  @ZCU_Rear::Current = this.Battery_Current.phys;
  @ZCU_Rear::Voltage = this.Battery_Voltage.phys;
}

/**
 * @brief 회생 토크 명령 메시지 수신 이벤트 핸들러
 * @note 상위 시스템으로부터 회생 제동 명령을 수신하여 처리
 *       - 회생 모드 설정
 *       - 목표 회생 토크 값 설정
 */
on message M001_Regen_Torque_Cmd
{
  @ZCU_Rear::Regen_Mode = this.Regen_Mode;
  @ZCU_Rear::Target_Torque = this.Target_Regen_Torque.phys;
}

/**
 * @brief 브레이크 라이트 제어 메시지 수신 이벤트 핸들러
 * @note 브레이크 라이트 점등 명령을 수신
 */
on message M013_Brake_Light_Ctrl
{
  @ZCU_Rear::Back_Light = this.Brake_Light_Command;
}
