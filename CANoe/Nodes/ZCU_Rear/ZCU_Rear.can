/*@!Encoding:65001*/
includes
{
  
}

variables
{
  msTimer mcu_ctrl_msg_Timer;
  const dword MCU_CTRL_MSG_TIMEOUT = 10;
  msTimer fb_msg_Timer;
  const dword FB_MSG_TIMEOUT = 100;
}

on start
{
  settimer(mcu_ctrl_msg_Timer, MCU_CTRL_MSG_TIMEOUT);
  settimer(fb_msg_Timer, FB_MSG_TIMEOUT);
}

on timer mcu_ctrl_msg_Timer
{
  message L008_MCU_Control mcu_ctrl_msg;
  
  mcu_ctrl_msg.Regen_Mode = @ZCU_Rear::Regen_Mode;
  mcu_ctrl_msg.Target_Torque.phys = @ZCU_Rear::Target_Torque;
  output(mcu_ctrl_msg);
  cancelTimer(mcu_ctrl_msg_Timer);
  settimer(mcu_ctrl_msg_Timer, MCU_CTRL_MSG_TIMEOUT);
}

on timer fb_msg_Timer
{
  
  message M006_Battery_Basic battery_msg;
  message M002_Regen_Torque_Feedback torque_msg;
  
  torque_msg.Actual_Regen_Torque.phys = @ZCU_Rear::Motor_Torque;
  output(torque_msg);
  
  battery_msg.Battery_SOC = @ZCU_Rear::SoC;
  battery_msg.Battery_Current.phys = @ZCU_Rear::Current;
  battery_msg.Battery_Voltage.phys = @ZCU_Rear::Voltage;
  battery_msg.Battery_Temp = 30;
  output(battery_msg);
  
  cancelTimer(fb_msg_Timer);
  settimer(fb_msg_Timer, FB_MSG_TIMEOUT);
}

on message L005_MCU_Detail_Status
{
  @ZCU_Rear::Motor_Torque = this.Motor_Torque.phys;
}

on message L007_BMS_Detail_Status
{
  @ZCU_Rear::SoC = this.Battery_SoC;
  @ZCU_Rear::Current = this.Battery_Current.phys;
  @ZCU_Rear::Voltage = this.Battery_Voltage.phys;
}

on message M001_Regen_Torque_Cmd
{
  @ZCU_Rear::Regen_Mode = this.Regen_Mode;
  @ZCU_Rear::Target_Torque = this.Target_Regen_Torque.phys;
}
