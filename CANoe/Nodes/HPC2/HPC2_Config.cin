/*@!Encoding:65001*/
/**
 * @file HPC_Config.cin
 * @brief HPC CAPL 스크립트의 모든 설정, 상수 및 전역 변수 정의
 */

variables
{
  const int ECU_ID = 0x01;
  const int SYSTEM_VERSION = 0x0100;

  const int MAIN_CYCLE = 10;
  const int WATCHDOG_TIMEOUT = 20;

  const float VEHICLE_INERTIA = 1.5;    // kg*m^2, 차량의 등가 관성 모멘트 (모터 기준)
  const float GEAR_RATIO = 9.1;         // 감속기 기어비
  const float WHEEL_RADIUS = 0.33;      // m, 바퀴 반경

  const float BATTERY_SOC_LIMIT = 95.0;
  const byte BATTERY_TEMP_MIN = 10;
  const byte BATTERY_TEMP_MAX = 45;
  const float MAX_DECEL_FOR_BRAKE_LIGHT = 1.3;

  const float MAX_PROPULSION_TORQUE = 350.0;
  const float MAX_REGEN_TORQUE_AT_PEDAL = 200.0;
  const byte APS_DEADZONE = 5;
  const byte BPPS_DEADZONE = 5;

  const dword FAULT_WATCHDOG_TIMEOUT = 0x00000001;
  const dword FAULT_CRITICAL_EXTERNAL = 0x00000002;
  const dword FAULT_BATTERY_PROTECTION = 0x00000004;

  enum SystemState
  {
    STATE_INIT = 0,
    STATE_NORMAL = 1,
    STATE_BATTERY_PROTECTION = 2,
    STATE_FAIL_SAFE = 3
  };

  enum RegenState
  {
    REGEN_OFF = 0,
    REGEN_LEVEL1 = 1,
    REGEN_LEVEL2 = 2,
    REGEN_LEVEL3 = 3,
    REGEN_AUTO = 4
  };

  struct V2XData
  {
    byte trafficLightDistance;
    byte trafficLightStatus;
    byte roadGrade;
    byte congestionLevel;
    dword timestamp;
  };

  struct DiagnosticData
  {
    byte cpuUsage;
    byte memoryUsage;
    word operatingHours;
    dword errorFlags;
  };

  msTimer timerMainTask;
  msTimer timerWatchdog;

  enum SystemState currentState;
  enum SystemState previousState;
  enum RegenState currentRegenMode;

  float currentVehicleSpeed;
  float currentMotorSpeed;
  float steeringAngle;
  byte apsPosition;
  byte bppsPosition;

  float targetMotorTorque;
  float currentRegenTorque;

  float maxRegenPower;
  float cumulativeRegenEnergy;
  float instantRegenPower;

  byte batterySOC;
  byte batteryTemp;

  dword faultRegister;
  byte watchdogCounter;
  dword gTaskCounter;

  struct V2XData v2xData;
  struct DiagnosticData diagnostics;
  
  byte gCrcData[10];
  long gCrcRetval;
  dword gCrcValue;

  float gAutoRegenBaseTorque;

  float gPrevVehicleSpeed_VD;
  dword gPrevTime_VD;
}
