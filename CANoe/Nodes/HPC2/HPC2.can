/*@!Encoding:65001*/
/**
 * @file HPC2.can
 * @brief HPC ECU의 이벤트 기반 메인 CAPL 스크립트
 */

includes
{
  #include "HPC2_Functions.cin"
  #include "HPC2_Config.cin"
  //#include "HPC_OTA.cin"
  //#include "EDT.cin"
}

/**
 * @brief 시뮬레이션 시작 이벤트 핸들러
 * @details 시스템 초기화, 전역 변수 설정, 타이머 시작 등을 수행
 */
on start
{
  HandleStartEvent();
}

/**
 * @brief 시뮬레이션 정지 이벤트 핸들러
 * @details 시스템 종료 작업을 수행하고 리소스를 정리
 */
on stopMeasurement
{
  HandleStopEvent();
}

/**
 * @brief 메인 태스크 타이머 이벤트 핸들러
 * @details 10ms 주기로 실행되어 다음 작업을 수행:
 *          - 토크 제어 명령 전송
 *          - 차량 물리 시뮬레이션 업데이트
 *          - 클러스터 디스플레이 업데이트 (100ms 주기)
 *          - 에너지 효율 계산 (200ms 주기)
 *          - 자동 모드 최적화 (500ms 주기)
 */
on timer timerMainTask
{
  HandleMainTaskTimer();
}

/**
 * @brief 워치독 타이머 이벤트 핸들러
 * @details 워치독 타임아웃 발생 시 FAIL_SAFE 상태로 전환
 */
on timer timerWatchdog
{
  HandleWatchdogTimeout();
}

/**
 * @brief 회생 제동 모드 변경 요청 메시지 수신 이벤트 핸들러
 * @details 운전자 또는 다른 ECU로부터의 모드 변경 요청을 처리하고 응답 전송
 */
on message M008_Mode_Change_Req
{
  HandleModeChangeReqMessage(this);
}

/**
 * @brief 배터리 기본 상태 메시지 수신 이벤트 핸들러
 * @details 배터리 SOC, 온도 정보를 수신하여 배터리 보호 상태 결정
 */
on message M006_Battery_Basic
{
  HandleBatteryBasicMessage(this);
}

/**
 * @brief 회생 토크 피드백 메시지 수신 이벤트 핸들러
 * @details 실제 회생 토크와 목표 토크 차이를 기반으로 마찰 제동 보상 요청
 */
on message M002_Regen_Torque_Feedback
{
  HandleRegenTorqueFeedbackMessage(this);
}

/**
 * @brief Fail-Safe 상태 메시지 수신 이벤트 핸들러 (Type 2)
 * @details 다른 ECU로부터 심각한 폴트 정보를 수신하여 FAIL_SAFE 상태로 전환
 */
on message M004_FailSafe_Status_2
{
  HandleFailSafeStatusMessage(this.Fault_Code);
}

/**
 * @brief Fail-Safe 상태 메시지 수신 이벤트 핸들러 (Type 3)
 * @details 다른 ECU로부터 심각한 폴트 정보를 수신하여 FAIL_SAFE 상태로 전환
 */
on message M004_FailSafe_Status_3
{
  HandleFailSafeStatusMessage(this.Fault_Code);
}

/**
 * @brief 차량 동역학 메시지 수신 이벤트 핸들러
 * @details APS 위치, 차량 속도, 조향각 정보를 수신하여 감속도 기반 제동등 제어
 */
on message M005_Vehicle_Dynamics
{
  HandleVehicleDynamicsMessage(this);
}

/**
 * @brief 브레이크 페달 메시지 수신 이벤트 핸들러
 * @details BPPS 위치 정보를 수신하여 제동 의도 파악
 */
on message M005_EXT_Brake_Pedal
{
  HandleBrakePedalMessage(this);
}
