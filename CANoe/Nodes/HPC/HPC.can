/*@!Encoding:65001*/
includes
{
  #include "HPC_Config.cin"
  #include "HPC_Functions.cin"
  //#include "HPC_OTA.cin"
  //#include "EDT.cin"
}

on start
{
  HandleStartEvent();
}

on stopMeasurement
{
  HandleStopEvent();
}

on timer timerMainTask
{
  HandleMainTaskTimer();
}

on timer timerWatchdog
{
  HandleWatchdogTimeout();
}

on message M008_Mode_Change_Req
{
  HandleModeChangeReqMessage(this);
}

on message M006_Battery_Basic
{
  HandleBatteryBasicMessage(this);
}

on message M002_Regen_Torque_Feedback
{
  HandleRegenTorqueFeedbackMessage(this);
}

on message M004_FailSafe_Status_2
{
  HandleFailSafeStatusMessage(this.Fault_Code);
}

on message M004_FailSafe_Status_3
{
  HandleFailSafeStatusMessage(this.Fault_Code);
}

on message M005_Vehicle_Dynamics
{
  HandleVehicleDynamicsMessage(this);
}

on message M005_EXT_Brake_Pedal
{
  HandleBrakePedalMessage(this);
}

/**
 * @brief 키보드 'f' 키 입력 이벤트 핸들러
 * @note 수동으로 HPC 통신 폴트를 주입하여 테스트
 */
on key 'f'
{
  HandleWatchdogTimeout();
}

/**
 * @brief 키보드 'c' 키 입력 이벤트 핸들러
 * @note 모든 폴트를 지우고 상태를 초기화
 */
on key 'c'
{
  TransitionToState(STATE_NORMAL);
}