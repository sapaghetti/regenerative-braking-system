/*@!Encoding:65001*/
/**
 * @file SW_Button.can
 * @brief 패널 버튼 입력을 감지하고 L004 메시지를 생성·전송하는 메인 CAPL 스크립트
 */

includes
{
  #include "SW_Button_Config.cin"
  #include "SW_Button_Functions.cin"
}

on start
{
  gEventCounter = 0;
  write("SW_Button Node: Started and waiting for panel inputs.");
}

on sysvar SysVar::SW_Button::ModeUp
{
  if(@this == 1)
  {
    gPressStartTime_ModeUp = timeNowNS() / 1000000;
    SendButtonMessage(BUTTON_ID_MODE_UP, BUTTON_ACTION_PRESS, 0);
  }
  else
  {
    dword pressDuration;
    pressDuration = timeNowNS() / 1000000 - gPressStartTime_ModeUp;
    SendButtonMessage(BUTTON_ID_MODE_UP, BUTTON_ACTION_RELEASE, (word)pressDuration);
  }
}

on sysvar SysVar::SW_Button::ModeDown
{
  if(@this == 1)
  {
    gPressStartTime_ModeDown = timeNowNS() / 1000000;
    SendButtonMessage(BUTTON_ID_MODE_DOWN, BUTTON_ACTION_PRESS, 0);
  }
  else
  {
    dword pressDuration;
    pressDuration = timeNowNS() / 1000000 - gPressStartTime_ModeDown;
    SendButtonMessage(BUTTON_ID_MODE_DOWN, BUTTON_ACTION_RELEASE, (word)pressDuration);
  }
}

on sysvar SysVar::SW_Button::ProfileChange
{
  if(@this == 1)
  {
    gPressStartTime_ProfileChange = timeNowNS() / 1000000;
    SendButtonMessage(BUTTON_ID_PROFILE_CHANGE, BUTTON_ACTION_PRESS, 0);
  }
  else
  {
    dword pressDuration;
    pressDuration = timeNowNS() / 1000000 - gPressStartTime_ProfileChange;
    SendButtonMessage(BUTTON_ID_PROFILE_CHANGE, BUTTON_ACTION_RELEASE, (word)pressDuration);
  }
}

on sysvar SysVar::SW_Button::AutoToggle
{
  if(@this == 1)
  {
    gPressStartTime_AutoToggle = timeNowNS() / 1000000;
    SendButtonMessage(BUTTON_ID_AUTO_TOGGLE, BUTTON_ACTION_PRESS, 0);
  }
  else
  {
    dword pressDuration;
    pressDuration = timeNowNS() / 1000000 - gPressStartTime_AutoToggle;
    SendButtonMessage(BUTTON_ID_AUTO_TOGGLE, BUTTON_ACTION_RELEASE, (word)pressDuration);
  }
}
