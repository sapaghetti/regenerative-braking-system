/*@!Encoding:65001*/
/**
 * @file ZCU_Center_Config.cin
 * @brief ZCU_Center CAPL 스크립트의 모든 설정, 상수 및 전역 변수 정의
 * @author jjongs2
 * @version 1.00
 * @date 2025-06-16
 */

variables
{
  /*******************************************************************************
   * 시스템 설정 상수
   ******************************************************************************/

  /** @brief ZCU_Center ECU 식별자 */
  const int ECU_ID = 0x03;
  /** @brief 시스템 버전 (Major.Minor) */
  const int SYSTEM_VERSION = 0x0100;
  /** @brief 메인 태스크 주기 (ms) */
  const int MAIN_CYCLE = 10;

  /*******************************************************************************
   * 통신 타임아웃 임계값
   ******************************************************************************/

  /** @brief HPC 통신 타임아웃 (ms) - M012는 100ms 주기이므로 300ms */
  const int TIMEOUT_HPC_M012 = 300;
  /** @brief HPC 통신 타임아웃 (ms) - M009는 이벤트성이므로 1000ms */
  const int TIMEOUT_HPC_M009 = 1000;
  /** @brief 최대 통신 실패 횟수 */
  const int MAX_COMM_FAILURES = 3;
  /** @brief HMI 응답 최대 대기 시간 (ms) */
  const int HMI_RESPONSE_TIMEOUT = 200;

  /*******************************************************************************
   * HMI 입력 검증 임계값
   ******************************************************************************/

  /** @brief 버튼 최소 눌림 시간 (ms) - 잘못된 입력 방지 */
  const int MIN_BUTTON_PRESS_TIME = 30;
  /** @brief 버튼 최대 눌림 시간 (ms) - 스틱 방지 */
  const int MAX_BUTTON_PRESS_TIME = 5000;
  /** @brief 음성 인식 최소 신뢰도 (%) */
  const int MIN_VOICE_CONFIDENCE = 70;
  /** @brief 연속 입력 최소 간격 (ms) - 중복 입력 방지 */
  const int MIN_INPUT_INTERVAL = 300;

  /*******************************************************************************
   * 모드 및 프로파일 상수
   ******************************************************************************/

  /** @brief 회생제동 모드 개수 */
  const int MAX_REGEN_MODES = 5;
  /** @brief Level 0 모드 */
  const byte MODE_LEVEL_0 = 0;
  /** @brief Level 1 모드 */
  const byte MODE_LEVEL_1 = 1;
  /** @brief Level 2 모드 */
  const byte MODE_LEVEL_2 = 2;
  /** @brief Level 3 모드 */
  const byte MODE_LEVEL_3 = 3;
  /** @brief Auto 모드 */
  const byte MODE_AUTO = 4;

  /** @brief 효율성 프로파일 */
  const byte PROFILE_EFFICIENCY = 0;
  /** @brief 편안함 프로파일 */
  const byte PROFILE_COMFORT = 1;

  /*******************************************************************************
   * 폴트 관리 비트 마스크
   ******************************************************************************/

  /** @brief HPC 통신 폴트 */
  const dword FAULT_HPC_COMM = 0x00000001;
  /** @brief 버튼 입력 폴트 */
  const dword FAULT_BUTTON_INPUT = 0x00000002;
  /** @brief 음성 인식 폴트 */
  const dword FAULT_VOICE_INPUT = 0x00000004;
  /** @brief 클러스터 표시 폴트 */
  const dword FAULT_CLUSTER_DISPLAY = 0x00000008;
  /** @brief HMI 응답 타임아웃 폴트 */
  const dword FAULT_HMI_TIMEOUT = 0x00000010;
  /** @brief 시스템 과부하 폴트 */
  const dword FAULT_SYSTEM_OVERLOAD = 0x00000020;
  /** @brief 모드 변경 실패 폴트 */
  const dword FAULT_MODE_CHANGE_FAIL = 0x00000040;

  /*******************************************************************************
   * 시스템 상태 열거형
   ******************************************************************************/

  /**
   * @brief 시스템의 현재 운영 상태를 나타내는 열거형
   */
  enum SystemState
  {
    STATE_INIT = 0,      /**< 초기화 상태 */
    STATE_NORMAL = 1,    /**< 정상 작동 상태 */
    STATE_DEGRADED = 2,  /**< 기능 저하 상태 */
    STATE_FAIL_SAFE = 3  /**< 안전 상태 */
  };

  /** @brief 현재 시스템 상태 */
  enum SystemState currentState;
  /** @brief 이전 시스템 상태 */
  enum SystemState previousState;

  /*******************************************************************************
   * HMI 입력 데이터 구조체
   ******************************************************************************/

  /**
   * @brief HMI 입력 관련 데이터를 저장하는 구조체
   */
  struct HMIInputData
  {
    /** @brief 마지막 버튼 입력 시간 */
    dword lastButtonTime;
    /** @brief 마지막 음성 입력 시간 */
    dword lastVoiceTime;
    /** @brief 마지막 버튼 ID */
    byte lastButtonID;
    /** @brief 마지막 버튼 액션 */
    byte lastButtonAction;
    /** @brief 마지막 음성 명령 타입 */
    byte lastVoiceCommandType;
    /** @brief 마지막 음성 명령 값 */
    byte lastVoiceCommandValue;
    /** @brief 마지막 음성 신뢰도 */
    byte lastVoiceConfidence;
    /** @brief 버튼 입력 유효성 */
    byte buttonValid;
    /** @brief 음성 입력 유효성 */
    byte voiceValid;
    /** @brief 펜딩 모드 변경 요청 */
    byte pendingModeRequest;
    /** @brief 요청된 모드 */
    byte requestedMode;
    /** @brief 요청 소스 */
    byte requestSource;
  };
  /** @brief HMI 입력 데이터 인스턴스 */
  struct HMIInputData hmiInput;

  /*******************************************************************************
   * 클러스터 표시 데이터 구조체
   ******************************************************************************/

  /**
   * @brief 클러스터 표시 관련 데이터를 저장하는 구조체
   */
  struct ClusterDisplayData
  {
    /** @brief 현재 표시 모드 */
    byte currentDisplayMode;
    /** @brief 이전 표시 모드 */
    byte previousDisplayMode;
    /** @brief 순간 회생 전력 (W) */
    dword instantRegenPower;
    /** @brief 누적 회생 에너지 (Wh) */
    dword cumulativeRegenEnergy;
    /** @brief 차량 속도 (분해능: 0.01 km/h) */
    word vehicleSpeed;
    /** @brief 모터 속도 (rpm) */
    word motorSpeed;
    /** @brief 경고 상태 비트마스크 */
    byte warningStatus;
    /** @brief 활성 프로파일 */
    byte activeProfile;
    /** @brief 클러스터 연결 상태 */
    byte clusterConnected;
    /** @brief 마지막 업데이트 시간 */
    dword lastUpdateTime;
    /** @brief 표시 데이터 유효성 */
    byte displayDataValid;
    /** @brief OTA 편안한 모드 활성화 여부 */
    byte comfortModeEnabled;
  };
  /** @brief 클러스터 표시 데이터 인스턴스 */
  struct ClusterDisplayData clusterDisplay;

  /*******************************************************************************
   * 통신 모니터링 구조체
   ******************************************************************************/

  /**
   * @brief 통신 상태 및 오류를 모니터링하기 위한 데이터를 저장하는 구조체
   */
  struct CommMonitor
  {
    /** @brief HPC M012 마지막 수신 시간 (ms) */
    dword lastRxTime_M012;
    /** @brief HPC M009 마지막 수신 시간 (ms) */
    dword lastRxTime_M009;
    /** @brief HPC M012 실패 횟수 */
    int failureCount_M012;
    /** @brief HPC M009 실패 횟수 */
    int failureCount_M009;
    /** @brief 통신 상태 비트 마스크 */
    byte commStatus;
    /** @brief M012 첫 메시지 수신 플래그 */
    byte firstMsgReceived_M012;
    /** @brief M009 첫 메시지 수신 플래그 */
    byte firstMsgReceived_M009;
    /** @brief 마지막 M008 전송 시간 */
    dword lastTxTime_M008;
    /** @brief M008 응답 대기 중 플래그 */
    byte waitingForResponse;
  };
  /** @brief 통신 모니터링 인스턴스 */
  struct CommMonitor commMon;

  /*******************************************************************************
   * 진단 데이터 구조체
   ******************************************************************************/

  /**
   * @brief 진단 정보를 저장하는 구조체
   */
  struct DiagnosticData
  {
    /** @brief CPU 사용률 (%) */
    byte cpuUsage;
    /** @brief 메모리 사용률 (%) */
    byte memoryUsage;
    /** @brief ECU 온도 (°C) */
    byte temperature;
    /** @brief 동작 시간 (hours) */
    word operatingHours;
    /** @brief 오류 플래그 */
    dword errorFlags;
    /** @brief HMI 응답 시간 측정 */
    dword lastResponseTime;
    /** @brief 평균 HMI 응답 시간 */
    dword averageResponseTime;
  };
  /** @brief 진단 데이터 인스턴스 */
  struct DiagnosticData diagnostics;

  /*******************************************************************************
   * 전역 변수
   ******************************************************************************/

  /** @brief M008 메시지 카운터 */
  byte counter_M008;
  /** @brief M004 메시지 카운터 */
  byte counter_M004;
  /** @brief M016 메시지 카운터 */
  byte counter_M016;
  
  /** @brief 폴트 레지스터 */
  dword faultRegister;
  /** @brief 메인 태스크 타이머 */
  msTimer timerMainTask;
  
  /** @brief 태스크 카운터 */
  dword gTaskCounter;
  /** @brief 시간 카운터 */
  int gHourCounter;
  /** @brief 워치독 카운터 */
  byte gWatchdogCounter;
  /** @brief 마지막 워치독 시간 */
  dword gLastWatchdogTime;
  
  /** @brief E2E 보호용 롤링 카운터 */
  byte gRollingCounter;
  /** @brief 마지막 E2E 검증 실패 시간 */
  dword gLastE2EFailTime;

  /*******************************************************************************
   * 요청 소스 열거형
   ******************************************************************************/

  /** @brief 버튼 요청 */
  const byte REQUEST_SOURCE_BUTTON = 0;
  /** @brief 음성 요청 */
  const byte REQUEST_SOURCE_VOICE = 1;
  /** @brief 자동 로직 요청 */
  const byte REQUEST_SOURCE_AUTO = 2;

  /*******************************************************************************
   * 버튼 ID 열거형
   ******************************************************************************/

  /** @brief 모드 증가 버튼 */
  const byte BUTTON_MODE_UP = 0;
  /** @brief 모드 감소 버튼 */
  const byte BUTTON_MODE_DOWN = 1;
  /** @brief 프로파일 변경 버튼 */
  const byte BUTTON_PROFILE_CHANGE = 2;
  /** @brief 자동 모드 토글 버튼 */
  const byte BUTTON_AUTO_TOGGLE = 3;

  /*******************************************************************************
   * 버튼 액션 열거형
   ******************************************************************************/

  /** @brief 버튼 눌림 */
  const byte BUTTON_ACTION_PRESS = 0;
  /** @brief 버튼 놓임 */
  const byte BUTTON_ACTION_RELEASE = 1;
  /** @brief 버튼 길게 눌림 */
  const byte BUTTON_ACTION_LONG_PRESS = 2;

  /*******************************************************************************
   * 음성 명령 타입 열거형
   ******************************************************************************/

  /** @brief 모드 변경 명령 */
  const byte VOICE_CMD_MODE_CHANGE = 0;
  /** @brief 프로파일 변경 명령 */
  const byte VOICE_CMD_PROFILE_CHANGE = 1;
  /** @brief 시스템 정보 요청 */
  const byte VOICE_CMD_SYSTEM_INFO = 2;

  /*******************************************************************************
   * 경고 상태 비트마스크
   ******************************************************************************/

  /** @brief 배터리 경고 */
  const byte WARNING_BATTERY = 0x01;
  /** @brief ABS 경고 */
  const byte WARNING_ABS = 0x02;
  /** @brief 시스템 고장 경고 */
  const byte WARNING_SYSTEM_FAULT = 0x04;
  /** @brief 통신 오류 경고 */
  const byte WARNING_COMM_ERROR = 0x08;
  /** @brief OTA 업데이트 경고 */
  const byte WARNING_OTA_UPDATE = 0x10;
}
