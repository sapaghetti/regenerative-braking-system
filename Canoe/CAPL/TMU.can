/*@!Encoding:65001*/
variables
{
  msTimer checkTimer;
  dword hFile;
  char ecu_buffer[256];
  char version_buffer[256];
  char change_buf[256];
  char ecu_info[4][10] = {"Init", "CGW", "TMU", "EDT"};
  char system_ver_buf[256];
  char system_ver[10][10];
  char ota_result;
  int i;
  int ecu_cnt = 3;
  int otaReady = 0;    // -1: , 0: 준비 안됨, 1: 사용자 승인 대기, 2: 승인됨, 3: 거부됨 4: 업데이트 완료
  int ecu_num = 0;
  int cur_version[11];
  int next_version[11];
  long result;
  long len = 256;
  
  message TMU_CGW_E_OTA_REQ otaReqMsg;
  message TMU_CGW_PE_OTA_DATA otaDataMsg;
  
}

on start
{
  setTimer(checkTimer, 1000);
}

on timer checkTimer
{
  
  if (otaReady == 0)
  {
    // OTA flag 감지 -> 
    
    hFile = openFileRead("C:\\vscodestudy\\OTA_download\\Sapaghetti.bin", 0);
    if (hFile != 0)
    {
      //result = fileGetBinaryBlock(version_buffer, len, hFile); // bin파일값 저장
      result = fileGetString(ecu_buffer, len, hFile);
      result = fileGetString(version_buffer, len, hFile);
      ecu_num = ecu_buffer[0] - '0';
      //@sysvar::Next_Ver[ecu_num] = version_buffer[0] - '0';
      next_version[ecu_num] = version_buffer[0] - '0';
      fileClose(hFile);
      if (result > 0 && cur_version[ecu_num] != next_version[ecu_num])
      {
        write(">>> OTA 준비됨 → CGW 에 승인 요청 전송");
        write(">> OTA ECU: %d, NEW VERSION %d", ecu_num, next_version[ecu_num]);
        // CGW 에 승인 요청 전송
        otaReqMsg.byte(0) = 0x01;  // OTA 승인 요청
        output(otaReqMsg);
        otaReady = 1;  // 사용자 응답 대기 상태로 변경
      }
    }
  }
  else if (otaReady == 2)
  {
    otaReady = -1;
    write("TMU -> CGW OTA 수행 명령 및 .bin 파일 전달");
    otaDataMsg.byte(0) = 0x03;  // TMU -> CGW
    otaDataMsg.byte(1) = (0x00 | (ecu_num << 4)) | next_version[ecu_num]; // 0x12 => 0001 -> ecu 정보, 0011 -> 버전 정보
     //write("%d",otaRequestMsg.byte(1));
    output(otaDataMsg);
  }
  else if (otaReady == 3)
  {
     otaReady = 1;  // 사용자 응답 대기 상태로 변경
     write(">>> CGW에 승인 요청 재전송");
     write(">> OTA ECU: %d, NEW VERSION %d", ecu_num, next_version[ecu_num]);
     // CGW 에 승인 요청 전송
     otaReqMsg.byte(0) = 0x01;  // OTA 승인 요청
     output(otaReqMsg);
  }
  else if (otaReady == 4)
  {
    //서버로 완료 플래그 보내는 코드 작성해야함
   
    hFile = openFileWrite("System_version.txt", 0);
    if (hFile != 0)
    {
      write(">>> System_version 작성");
      cur_version[(ota_result & 0xF0) >> 4] = ota_result & 0x0F;
      for (i = 1; i <= ecu_cnt; i++)
      {
        //snprintf(system_ver_buf, len, "%s: %d\n", ecu_info[i], @sysvar::Cur_Ver[i]);
        snprintf(system_ver_buf, len, "%s: %d\n", ecu_info[i], cur_version[i]);
        filePutString(system_ver_buf, len, hFile);
      }
      fileClose(hFile);
    }
    otaReady = 0;
  }
  setTimer(checkTimer, 1000);
}

on message CGW_TMU_E_OTA_REQ
{
  if (this.byte(0) == 0x01)
  {
    otaReady = 2;  // 사용자 승인됨
  }
  else if (this.byte(0) == 0x02)
  {
    otaReady = 3;  // 사용자 거부됨
  }
}
on message CGW_TMU_E_OTA_RESULT
{
  if (this.byte(0) == 0x05)  // OTA 완료
  {
    otaReady = 4;
    ota_result = this.byte(1);
  }
}
on message CGW_TMU_E_VER_INFO
{
  cur_version[(this.byte(0) & 0xF0) >> 4] = this.byte(0) & 0x0F;
}
on message EDT_TMU_E_VER_INFO
{
  cur_version[(this.byte(0) & 0xF0) >> 4] = this.byte(0) & 0x0F;
}