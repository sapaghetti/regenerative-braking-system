/*@!Encoding:65001*/
includes
{
  #include "../../CANoe/Nodes/ZCU_Front/ZCU_Front_Config.cin"
  #include "../../CANoe/Nodes/ZCU_Front/ZCU_Front_Functions.cin"
}

on timer timerMainTask
{
  HandleMainTaskTimer();
}

on message L001_EPAS_Data
{
  HandleEpasMessage(this);
}

on message L002_ADAS_Sensor
{
  HandleAdasMessage(this);
}

export testcase TC_UNIT_201()
{
  byte returnValue;

  TestStep("실행", "ValidateSensorRange(50.0, 0.0, 100.0) 함수를 호출합니다.");
  returnValue = ValidateSensorRange(50.0, 0.0, 100.0);

  TestStep("검증", "반환 값이 0인지 확인합니다.");
  if (returnValue == 0)
  {
    TestStepPass("결과", "정상 범위 내의 값에 대해 예상대로 0을 반환했습니다.");
  }
  else
  {
    TestStepFail("결과", "반환 값이 %d 입니다. 예상 값: 0", returnValue);
  }
}

export testcase TC_UNIT_202()
{
  byte returnValue;

  TestStep("실행", "ValidateSensorRange(101.0, 0.0, 100.0) 함수를 호출합니다.");
  returnValue = ValidateSensorRange(101.0, 0.0, 100.0);

  TestStep("검증", "반환 값이 2인지 확인합니다.");
  if (returnValue == 2)
  {
    TestStepPass("결과", "범위를 초과하는 값에 대해 예상대로 2를 반환했습니다.");
  }
  else
  {
    TestStepFail("결과", "반환 값이 %d 입니다. 예상 값: 2", returnValue);
  }
}

export testcase TC_UNIT_203()
{
  TestStep("준비", "전역 변수를 초기화합니다.");
  InitializeGlobals();

  TestStep("실행 1", "SetFault(FAULT_EPAS_COMM)를 호출합니다.");
  SetFault(FAULT_EPAS_COMM);

  TestStep("검증 1", "faultRegister와 diagnostics.errorFlags에 FAULT_EPAS_COMM 비트가 설정되었는지 확인합니다.");
  if ((faultRegister & FAULT_EPAS_COMM) != 0 && (diagnostics.errorFlags & FAULT_EPAS_COMM) != 0)
  {
    TestStepPass("SetFault 검증", "SetFault 호출 후 faultRegister와 diagnostics.errorFlags에 폴트가 정상 설정되었습니다.");
  }
  else
  {
    TestStepFail("SetFault 검증", "SetFault 호출 후 폴트가 설정되지 않았습니다. (faultRegister: 0x%08X, errorFlags: 0x%08X)", faultRegister, diagnostics.errorFlags);
  }

  TestStep("실행 2", "ClearFault(FAULT_EPAS_COMM)를 호출합니다.");
  ClearFault(FAULT_EPAS_COMM);

  TestStep("검증 2", "faultRegister와 diagnostics.errorFlags에서 FAULT_EPAS_COMM 비트가 해제되었는지 확인합니다.");
  if ((faultRegister & FAULT_EPAS_COMM) == 0 && (diagnostics.errorFlags & FAULT_EPAS_COMM) == 0)
  {
    TestStepPass("ClearFault 검증", "ClearFault 호출 후 faultRegister와 diagnostics.errorFlags에서 폴트가 정상 해제되었습니다.");
  }
  else
  {
    TestStepFail("ClearFault 검증", "ClearFault 호출 후 폴트가 해제되지 않았습니다. (faultRegister: 0x%08X, errorFlags: 0x%08X)", faultRegister, diagnostics.errorFlags);
  }
}

export testcase TC_UNIT_204()
{
  byte returnValue;

  TestStep("준비", "시스템 변수 @ZCU_Front::Firmware_Signature를 정상 값(0xDEADBEEF)으로 설정합니다.");
  SysSetVariableDWord("ZCU_Front", "Firmware_Signature", 0xDEADBEEF);

  TestStep("실행", "PerformSecureBoot() 함수를 호출합니다.");
  returnValue = PerformSecureBoot();

  TestStep("검증", "반환 값이 1인지 확인합니다.");
  if (returnValue == 1)
  {
    TestStepPass("결과", "올바른 서명에 대해 예상대로 1을 반환했습니다.");
  }
  else
  {
    TestStepFail("결과", "반환 값이 %d 입니다. 예상 값: 1", returnValue);
  }
}

export testcase TC_UNIT_205()
{
  byte returnValue;

  TestStep("준비", "시스템 변수 @ZCU_Front::Firmware_Signature를 비정상 값(0xBADF00D)으로 설정합니다.");
  SysSetVariableDWord("ZCU_Front", "Firmware_Signature", 0xBADF00D);

  TestStep("실행", "PerformSecureBoot() 함수를 호출합니다.");
  returnValue = PerformSecureBoot();

  TestStep("검증", "반환 값이 0인지 확인합니다.");
  if (returnValue == 0)
  {
    TestStepPass("결과", "잘못된 서명에 대해 예상대로 0을 반환했습니다.");
  }
  else
  {
    TestStepFail("결과", "반환 값이 %d 입니다. 예상 값: 0", returnValue);
  }

  SysSetVariableDWord("ZCU_Front", "Firmware_Signature", 0xDEADBEEF);
}

export testcase TC_INT_201()
{
  message L001_EPAS_Data msg;

  TestStep("준비", "L001_EPAS_Data 메시지 전송 중지, 전역 변수 초기화, FAULT_EPAS_COMM 폴트를 설정합니다.");
  TestDisableMsg(L001_EPAS_Data);
  InitializeGlobals();
  SetFault(FAULT_EPAS_COMM);

  TestStep("실행", "정상적인 L001_EPAS_Data 메시지 (카운터=1, 조향각=50.0)를 전송합니다.");
  msg.Message_Counter = 1;
  msg.Steering_Angle.phys = 50.0;
  output(msg);
  testWaitForTimeout(5);

  TestStep("검증", "센서값 업데이트, 실패 카운트 리셋, 폴트 해제 여부를 확인합니다.");
  if (sensors.steeringAngle == 50.0 && commMon.failureCount_EPAS == 0 && (faultRegister & FAULT_EPAS_COMM) == 0)
  {
    TestStepPass("결과", "메시지 핸들러가 정상적으로 통합 동작했습니다. (Angle=%.1f, FailCount=%d, FaultCleared)", sensors.steeringAngle, commMon.failureCount_EPAS);
  }
  else
  {
    TestStepFail("결과", "메시지 핸들러 통합 동작 실패. (Angle=%.1f, FailCount=%d, FaultRegister=0x%08X)", sensors.steeringAngle, commMon.failureCount_EPAS, faultRegister);
  }

  TestEnableMsg(L001_EPAS_Data);
}

export testcase TC_INT_202()
{
  message L001_EPAS_Data msg;

  TestStep("준비", "L001_EPAS_Data 메시지 전송 중지, 전역 변수 초기화, gLastEpasCounter를 1로 설정합니다.");
  TestDisableMsg(L001_EPAS_Data);
  InitializeGlobals();
  gLastEpasCounter = 1;

  TestStep("실행", "비순차적인 L001_EPAS_Data 메시지 (카운터=3)를 전송합니다.");
  msg.Message_Counter = 3;
  output(msg);
  testWaitForTimeout(5);

  TestStep("검증", "실패 카운트 증가 및 폴트 설정 여부를 확인합니다.");
  if (commMon.failureCount_EPAS == 1 && (faultRegister & FAULT_EPAS_COMM) != 0)
  {
    TestStepPass("결과", "카운터 오류 시 통신 폴트를 정상적으로 설정했습니다. (FailCount=%d)", commMon.failureCount_EPAS);
  }
  else
  {
    TestStepFail("결과", "카운터 오류 시 폴트 설정 실패. (FailCount=%d, FaultRegister=0x%08X)", commMon.failureCount_EPAS, faultRegister);
  }

  TestEnableMsg(L001_EPAS_Data);
}

export testcase TC_INT_203()
{
  message L001_EPAS_Data msg;

  TestStep("준비", "L001_EPAS_Data 메시지 전송을 중지하고, 전역 변수를 초기화합니다.");
  TestDisableMsg(L001_EPAS_Data);
  InitializeGlobals();

  TestStep("실행", "L001_EPAS_Data 메시지 전송 후 500ms 대기하여 timerMainTask 핸들러가 충분히 실행되도록 합니다.");
  SetTimerCyclic(timerMainTask, MAIN_CYCLE);
  msg.Message_Counter = 1;
  output(msg);
  TestWaitForTimeout(500);
  CancelTimer(timerMainTask);

  TestStep("검증", "FAULT_EPAS_COMM 폴트가 설정되었는지 확인합니다.");
  if ((faultRegister & FAULT_EPAS_COMM) != 0)
  {
    TestStepPass("결과", "주기적 태스크 통합으로 통신 타임아웃 폴트를 정상적으로 감지했습니다.");
  }
  else
  {
    TestStepFail("결과", "주기적 태스크 통합으로 통신 타임아웃을 감지하지 못했습니다. (FaultRegister=0x%08X)", faultRegister);
  }

  TestEnableMsg(L001_EPAS_Data);
}

export testcase TC_INT_204()
{
  TestStep("준비", "전역 변수를 초기화하고, currentState를 STATE_NORMAL로 설정합니다.");
  InitializeGlobals();
  currentState = STATE_NORMAL;

  TestStep("실행", "치명적인 폴트(FAULT_BPPS_SENSOR)를 설정합니다.");
  SetFault(FAULT_BPPS_SENSOR);

  TestStep("검증", "currentState가 STATE_FAIL_SAFE로 즉시 전이되었는지 확인합니다.");
  if (currentState == STATE_FAIL_SAFE)
  {
    TestStepPass("결과", "SetFault 호출 시 UpdateSystemState가 통합 호출되어 STATE_FAIL_SAFE로 정상 전이되었습니다.");
  }
  else
  {
    TestStepFail("결과", "상태가 전이되지 않았습니다. (currentState=%d, Expected=%d)", currentState, STATE_FAIL_SAFE);
  }
}

export testcase TC_SW_201()
{
  TestStep("준비", "시뮬레이션된 APS/BPPS 값을 설정합니다. (@ZCU_Front::APS_Position=50.0, @ZCU_Front::BPPS_Position=25.0)");
  HandleStartEvent();
  SysSetVariableFloat("ZCU_Front", "APS_Position", 50.0);
  SysSetVariableFloat("ZCU_Front", "BPPS_Position", 25.0);

  TestStep("실행 및 검증 1", "20ms 내에 M005_Vehicle_Dynamics 메시지를 수신하고 APS_Position 신호 값을 확인합니다.");
  if (TestWaitForMessage(M005_Vehicle_Dynamics, 20) == 1)
  {
    if ($M005_Vehicle_Dynamics::APS_Position.phys == 50.0)
    {
      TestStepPass("M005 검증", "M005 메시지를 수신했으며 APS_Position 값이 정확합니다. (Value=%.1f)", $M005_Vehicle_Dynamics::APS_Position.phys);
    }
    else
    {
      TestStepFail("M005 검증", "APS_Position 값이 %.1f 입니다. 예상 값: 50.0", $M005_Vehicle_Dynamics::APS_Position.phys);
    }
  }
  else
  {
    TestStepFail("M005 검증", "20ms 내에 M005_Vehicle_Dynamics 메시지를 수신하지 못했습니다.");
  }

  TestStep("실행 및 검증 2", "10ms 내에 M005_EXT_Brake_Pedal 메시지를 수신하고 BPPS_Position 신호 값을 확인합니다.");
  if (TestWaitForMessage(M005_EXT_Brake_Pedal, 10) == 1)
  {
    if ($M005_EXT_Brake_Pedal::BPPS_Position.phys == 25.0)
    {
      TestStepPass("M005_EXT 검증", "M005_EXT 메시지를 수신했으며 BPPS_Position 값이 정확합니다. (Value=%.1f)", $M005_EXT_Brake_Pedal::BPPS_Position.phys);
    }
    else
    {
      TestStepFail("M005_EXT 검증", "BPPS_Position 값이 %.1f 입니다. 예상 값: 25.0", $M005_EXT_Brake_Pedal::BPPS_Position.phys);
    }
  }
  else
  {
    TestStepFail("M005_EXT 검증", "10ms 내에 M005_EXT_Brake_Pedal 메시지를 수신하지 못했습니다.");
  }
}
